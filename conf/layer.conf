## conf/layer.conf
```bitbake
# We have a conf and classes directory, add to BBPATH
BBPATH .= ":${LAYERDIR}"

# We have recipes-* directories, add to BBFILES
BBFILES += "${LAYERDIR}/recipes-*/*/*.bb \
            ${LAYERDIR}/recipes-*/*/*.bbappend"

BBFILE_COLLECTIONS += "meta-yps2021-debugging"
BBFILE_PATTERN_meta-yps2021-debugging = "^${LAYERDIR}/"
BBFILE_PRIORITY_meta-yps2021-debugging = "10"

LAYERDEPENDS_meta-yps2021-debugging = "core"
LAYERSERIES_COMPAT_meta-yps2021-debugging = "honister"
```
